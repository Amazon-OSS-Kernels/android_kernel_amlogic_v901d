## bootable/bootloader/uboot-amlogic/v901d/bl33/board/amlogic/defconfigs/lagunaf_defconfig
```kconfig
CONFIG_ARM=y
CONFIG_TARGET_MESON_TM2=y
CONFIG_LAGUNAF=y
CONFIG_DM=y
CONFIG_DM_GPIO=y
CONFIG_AML_GPIO=y
CONFIG_MTK_BT_USB=y
CONFIG_FASTBOOT_SLOT_SWITCHING=n
```

## bootable/bootloader/uboot-amlogic/v901d/bl33/board/amlogic/lagunaf/Kconfig
```kconfig
if TARGET_MESON_TM2

config SYS_CPU
	string
	default "armv8"

config SYS_BOARD
	string
	default "lagunaf"

config SYS_VENDOR
	string
	default "amlogic"

config SYS_SOC
	string
	default "tm2"

config SYS_CONFIG_NAME
	default "lagunaf"

config MTK_BT_USB
    bool "enable mtk bt usb function"
    default n
    help
        select this item will enable mtk bt usb device

config FASTBOOT_SLOT_SWITCHING
	bool "enable switching active_slots using fastboot"
	default n
	help
		select this item will enable fastboot active_slot switching

endif
```

## kernel/amlogic/v901d/4.9/drivers/amlogic/ethernet/phy/Kconfig
```kconfig
#
# PHY Layer Configuration
#

config AMLOGIC_INTERNAL_PHY
	tristate "Drivers for amlogic internal phy"
	---help---
	  Currently supports the amlogic internal phy.
	  This module implements the amlogic internal phy,
	  modify the dts file to switch internal external phy.

	  if in doube, ask yizhou.

config WOL_POWER
	bool "Enable or disable wol power control"
	default y
	help
		if enable WOL_POWER config, will create /proc/wol_enable node.
		use the node to control wol power pin
```

## kernel/amlogic/v901d/4.9/drivers/amlogic/ext_hdmiin/sii9293/linux_driver/Kconfig
```kconfig
#
#Hdmirx SiI9293 Device Driver Configuration
#

menuconfig AML_SII9293
    bool "Amlogic SII9293 device driver"
    default  n
    help
         Amlogic SII9293 device driver.

if AML_SII9293

config MHAWB_SUPPORT
	bool
	prompt "MHL Media Data Tunneling Support"
	default n
	---help---
	  This option controls whether or not Silicon Image MHL transmitter
	  drivers include support for Media Data Tunneling (MDT).  MDT
	  support enables HID events generated by HID devices attached to
	  an MDT capable MHL sink to be passed over the MHL connection
	  to the system.

config DEBUG_DRIVER
	bool
	prompt "Enable debug messages in kernel"
	default n

config SII5293_RX
	tristate
	prompt "Silicon Image 5293 HDMI to MHL Rx"
	depends on I2C
	default n

endif
```

## kernel/amlogic/v901d/4.9/drivers/amlogic/power/Kconfig
```kconfig
config AMLOGIC_POWER
	bool "Amloigc power related driver support"
	default n
	help
		this config enables to use amlogic power management driver
		Say y here if you want power related driver(pmu/dvfs) support

config DUMMY_AC
	bool "Dummy AC power supply driver"
	help
	  This enables the Dummy AC driver.
	  Say Y here to enable support for Dummy AC driver

config AMLOGIC_PMU_OF
	bool "Amlogic Power OF support"
	depends on AMLOGIC_POWER
	depends on I2C
	default n
	help
		Power management device tree support

source "drivers/amlogic/power/aml_pmu/Kconfig"
source "drivers/amlogic/power/aml_dvfs/Kconfig"
```

## kernel/amlogic/v901d/4.9/drivers/amlogic/usb_power/Kconfig
```kconfig
#
# USB Power control Configuration
#

config AMLOGIC_USB_POWER
	bool "Drivers for amlogic USB power control"
	default y
	help
		if enable AMLOGIC_USB_POWER config, Control usb 5v pin
```
